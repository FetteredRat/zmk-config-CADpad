/*
 * Copyright (c) 2020 Pete Johanson
 *
 * SPDX-License-Identifier: MIT
 */

 #include <dt-bindings/zmk/keys.h>

 / {
     chosen {
         zmk,kscan = &kscan0;
     };
 
     kscan0: kscan {
         compatible = "zmk,kscan-gpio-matrix";
    col-gpios
        = <&pro_micro 14 GPIO_ACTIVE_HIGH>
        , <&pro_micro 15 GPIO_ACTIVE_HIGH>
        , <&pro_micro 18 GPIO_ACTIVE_HIGH>
        , <&pro_micro 19 GPIO_ACTIVE_HIGH>
        , <&pro_micro 20 GPIO_ACTIVE_HIGH>;

        diode-direction = "col2row";
        row-gpios
            = <&pro_micro 4 (GPIO_PULL_UP | GPIO_ACTIVE_LOW)>
            , <&pro_micro 5 (GPIO_PULL_UP | GPIO_ACTIVE_LOW)>
            , <&pro_micro 6 (GPIO_PULL_UP | GPIO_ACTIVE_LOW)>
            , <&pro_micro 7 (GPIO_PULL_UP | GPIO_ACTIVE_LOW)>;
    };
 };
